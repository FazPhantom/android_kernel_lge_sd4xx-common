## arch/arm64/hotplug/Kconfig
```kconfig
menu "Custom Hotplug drivers"

config CUSTOM_HOTPLUG
	bool "Enable custom hotplug support"

config ALUCARD_CONTROL
	bool "Alucard"
	depends on CUSTOM_HOTPLUG
	help
	  Known for being battery friendly. Developed by Alucard_24@XDA

config BRICKED_HOTPLUG
	bool "Enable kernel based mpdecision"
	depends on MSM_RUN_QUEUE_STATS
	default y
	help
	  This enables kernel based multi core control.
	  (up/down hotplug based on load)

endmenu
```
